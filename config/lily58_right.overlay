&left_encoder {
    a-gpios = <&pro_micro 21 0>;
    b-gpios = <&pro_micro 20 0>;
};

&vbatt {
    compatible = "zmk,battery-voltage-divider";
    io-channels = <&adc 5>;
    output-ohms = <1000000>;
    full-ohms = <2000000>;
};
