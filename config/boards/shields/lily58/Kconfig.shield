## config/boards/shields/lily58/Kconfig.shield
```kconfig
config SHIELD_LILY58_BATTERY_LEFT
    def_bool $(shields_list_contains,lily58_battery_left)

config SHIELD_LILY58_BATTERY_RIGHT
    def_bool $(shields_list_contains,lily58_battery_right)
```
